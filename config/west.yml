## config/west.yml
```yaml
manifest:
  defaults:
    revision: v0.3
  remotes:
    - name: zmkfirmware
      url-base: https://github.com/zmkfirmware
      # kyek / duckyb
    - name: duckyb
      url-base: https://github.com/duckyb
    - name: urob
      url-base: https://github.com/urob
    - name: gpeye
      url-base: https://github.com/GPeye
    # Additional modules containing boards/shields/custom code can be listed here as well
    # See https://docs.zephyrproject.org/3.2.0/develop/west/manifest.html#projects
  projects:
    - name: zmk
      remote: zmkfirmware
      revision: v0.3.0
      import: app/west.yml

    - name: urchin-zmk-module
      remote: duckyb
      revision: main

          # ZMK modules
    - name: zmk-adaptive-key
      remote: urob
      path: modules/zmk/adaptive-key
    - name: zmk-auto-layer
      remote: urob
      path: modules/zmk/auto-layer
    - name: zmk-helpers
      remote: urob
      path: modules/zmk/helpers
    - name: zmk-leader-key
      remote: urob
      path: modules/zmk/leader-key
    - name: zmk-tri-state
      remote: urob
      path: modules/zmk/tri-state
    - name: zmk-unicode
      remote: urob
      path: modules/zmk/unicode
    - name: hammerbeam-slideshow
      remote: gpeye
      revision: main

      # Temporarily overload Zephyr until
    # https://github.com/zmkfirmware/zephyr/pull/40 is merged.
    - name: zephyr
      remote: zmkfirmware
      revision: v3.5.0+zmk-fixes
      clone-depth: 1
      import:
        # Only enable most commonly used boards. For less common hardware one
        # may need to enable additional modules.
        name-allowlist:
          - cmsis
          - hal_nordic
          - hal_rpi_pico
          - hal_stm32
          - lvgl
          - tinycrypt
  self:
    path: config
```
